## boards/shields/mkbd_macropad/Kconfig.shield
```kconfig
config SHIELD_MKBD_MACROPAD_LEFT
    def_bool $(shields_list_contains,mkbd_macropad_left)

config SHIELD_MKBD_MACROPAD_RIGHT
    def_bool $(shields_list_contains,mkbd_macropad_right)
```
